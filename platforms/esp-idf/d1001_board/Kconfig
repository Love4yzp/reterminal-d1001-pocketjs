## platforms/esp-idf/d1001_board/Kconfig
```kconfig
menu "D1001 board"

config D1001_TOUCH_INT_GPIO
    int "GSL3670 interrupt GPIO (-1 disables)"
    default 16

endmenu
```

## platforms/esp-idf/pocket_hot_push_esp/Kconfig
```kconfig
menuconfig D1001_HOT_PUSH
    bool "Development Wi-Fi app hot push"
    default n
    depends on IDF_TARGET_ESP32P4
    help
        Expose an authenticated POST /push endpoint on the STA interface.
        This development endpoint writes PKAP short images to the apps partition.

config D1001_HOT_PUSH_TOKEN
    string "Development Wi-Fi hot-push bearer token"
    default ""
    depends on IDF_TARGET_ESP32P4
    help
        The HTTP server starts only when D1001_HOT_PUSH is enabled and this
        token is non-empty. Clients send it as Authorization: Bearer <token>.
```

## platforms/esp-idf/pocket_wifi_esp/Kconfig
```kconfig
menu "D1001 Wi-Fi"

config D1001_WIFI_SSID
    string "First station SSID (empty preserves existing connection behavior)"
    default ""
    depends on IDF_TARGET_ESP32P4

config D1001_WIFI_PASSWORD
    string "First station password"
    default ""
    depends on IDF_TARGET_ESP32P4
    help
        Keep the password in an ignored sdkconfig.local or another local
        configuration source. It is never logged by the D1001 Wi-Fi component.

config D1001_WIFI_SSID_2
    string "Second station SSID (optional)"
    default ""
    depends on IDF_TARGET_ESP32P4
    help
        After repeated NO_AP_FOUND or authentication failures on one preset,
        the station rotates to the next configured preset. The order is
        D1001_WIFI_SSID, then D1001_WIFI_SSID_2. Leave empty to keep only the
        first preset.

config D1001_WIFI_PASSWORD_2
    string "Second station password"
    default ""
    depends on IDF_TARGET_ESP32P4
    help
        Keep the password in an ignored sdkconfig.local or another local
        configuration source. It is never logged by the D1001 Wi-Fi component.

endmenu
```

## programs/reterminal-d1001/components/pocket_d1001/Kconfig
```kconfig
menu "D1001 panel services"

config D1001_SNTP_SERVER
    string "SNTP server used to update the PCF8563 RTC"
    default "pool.ntp.org"
    depends on IDF_TARGET_ESP32P4

config D1001_TIMEZONE
    string "POSIX timezone for panel display; the RTC stores UTC"
    default "CST-8"
    depends on IDF_TARGET_ESP32P4

config D1001_HA_BASE_URL
    string "Home Assistant base URL"
    default ""
    depends on IDF_TARGET_ESP32P4

config D1001_HA_TOKEN
    string "Home Assistant long-lived access token"
    default ""
    depends on IDF_TARGET_ESP32P4
    help
        Keep this in ignored local configuration. The token is passed to the
        panel worker in memory and is never logged.

config D1001_HA_LIGHT_ENTITY
    string "Optional Home Assistant light entity_id"
    default ""
    depends on IDF_TARGET_ESP32P4

config D1001_HA_SELFTEST
    bool "Exercise onboard RGB and one mock HA light command"
    default n
    depends on IDF_TARGET_ESP32P4

endmenu
```

## programs/reterminal-d1001/sdkconfig.defaults
```kconfig
CONFIG_IDF_TARGET="esp32p4"
CONFIG_ESP32P4_SELECTS_REV_LESS_V3=y
CONFIG_ESP32P4_REV_MIN_100=y
CONFIG_ESPTOOLPY_FLASHMODE_QIO=y
CONFIG_ESPTOOLPY_FLASHSIZE_16MB=y
CONFIG_PARTITION_TABLE_CUSTOM=y
CONFIG_PARTITION_TABLE_CUSTOM_FILENAME="partitions.csv"
CONFIG_COMPILER_OPTIMIZATION_PERF=y
CONFIG_FREERTOS_HZ=1000
CONFIG_SPIRAM=y
CONFIG_SPIRAM_SPEED_200M=y
CONFIG_SPIRAM_USE_MALLOC=y
CONFIG_CACHE_L2_CACHE_128KB=y
CONFIG_CACHE_L2_CACHE_LINE_128B=y
# FAT data.fs on the internal storage partition.
CONFIG_FATFS_LFN_HEAP=y
# ESP32-C6 over SDIO slot 1; only its existing firmware is used.
CONFIG_SLAVE_IDF_TARGET_ESP32C6=y
CONFIG_ESP_HOSTED_P4_DEV_BOARD_NONE=y
CONFIG_ESP_HOSTED_SDIO_SLOT_1=y
CONFIG_ESP_HOSTED_HOST_SDIO_PIN_CMD=6
CONFIG_ESP_HOSTED_HOST_SDIO_PIN_CLK=11
CONFIG_ESP_HOSTED_HOST_SDIO_PIN_D0=7
CONFIG_ESP_HOSTED_HOST_SDIO_PIN_D1=8
CONFIG_ESP_HOSTED_HOST_SDIO_PIN_D2=9
CONFIG_ESP_HOSTED_HOST_SDIO_PIN_D3=10
CONFIG_ESP_HOSTED_HOST_RESET_GPIO=13
CONFIG_ESP_HOSTED_AUTO_CALL_INIT_BEFORE_APP_MAIN=n
CONFIG_ESP_HOSTED_DFLT_TASK_FROM_SPIRAM=y
CONFIG_EH_HOST_PORT_DMA_PREFER_SPIRAM=y
CONFIG_LWIP_TCP_WND_DEFAULT=16384
CONFIG_SPIRAM_TRY_ALLOCATE_WIFI_LWIP=y
CONFIG_MBEDTLS_EXTERNAL_MEM_ALLOC=y
CONFIG_MBEDTLS_HAVE_TIME_DATE=y
# SC2356 / SC202CS MIPI-CSI camera BSP (single-shot PSRAM capture).
CONFIG_IDF_EXPERIMENTAL_FEATURES=y
CONFIG_CAMERA_SC202CS=y
CONFIG_CAMERA_SC202CS_AUTO_DETECT_MIPI_INTERFACE_SENSOR=y
CONFIG_CAMERA_SC202CS_MIPI_RAW8_1280X720_30FPS=y
CONFIG_CAMERA_SC202CS_MIPI_DEFAULT_FMT_RAW8_1280X720_30FPS=y
CONFIG_CAMERA_SC202CS_DEFAULT_IPA_JSON_CONFIGURATION_FILE=y
CONFIG_ESP_VIDEO_ENABLE_MIPI_CSI_VIDEO_DEVICE=y
CONFIG_ESP_VIDEO_DISABLE_MIPI_CSI_DRIVER_BACKUP_BUFFER=y
CONFIG_ESP_VIDEO_ENABLE_DVP_VIDEO_DEVICE=n
CONFIG_ESP_VIDEO_ENABLE_SPI_VIDEO_DEVICE=n
CONFIG_ESP_VIDEO_ENABLE_USB_UVC_VIDEO_DEVICE=n
CONFIG_ESP_VIDEO_ENABLE_ISP_VIDEO_DEVICE=n
CONFIG_ESP_VIDEO_ENABLE_ISP_PIPELINE_CONTROLLER=n
CONFIG_ESP_VIDEO_ENABLE_CAMERA_MOTOR_CONTROLLER=n
CONFIG_ESP_VIDEO_ENABLE_HW_H264_VIDEO_DEVICE=n
CONFIG_ESP_VIDEO_ENABLE_HW_JPEG_ENC_VIDEO_DEVICE=n
CONFIG_ESP_VIDEO_ENABLE_HW_JPEG_DEC_VIDEO_DEVICE=n
CONFIG_ESP_VIDEO_STREAM_STOP_DRAIN_FRAMES=1
```
